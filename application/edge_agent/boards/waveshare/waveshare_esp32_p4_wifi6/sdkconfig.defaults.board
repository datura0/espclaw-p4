## application/edge_agent/boards/waveshare/waveshare_esp32_p4_wifi6/sdkconfig.defaults.board
```kconfig
CONFIG_ESPTOOLPY_FLASHMODE_QIO=y
CONFIG_ESPTOOLPY_FLASHFREQ_80M=y
CONFIG_ESPTOOLPY_FLASHSIZE_32MB=y
CONFIG_SPIRAM=y
CONFIG_SPIRAM_MODE_HEX=y
CONFIG_SPIRAM_SPEED_200M=y

#
# Board Manager Peripheral Support
#
CONFIG_ESP_BOARD_PERIPH_GPIO_SUPPORT=y
CONFIG_ESP_BOARD_PERIPH_I2C_SUPPORT=y
CONFIG_ESP_BOARD_PERIPH_I2S_SUPPORT=y
CONFIG_ESP_BOARD_PERIPH_DSI_SUPPORT=y
CONFIG_ESP_BOARD_PERIPH_LDO_SUPPORT=y
CONFIG_ESP_BOARD_PERIPH_LEDC_SUPPORT=y

#
# Board Manager Device Support
#
CONFIG_ESP_BOARD_DEV_AUDIO_CODEC_SUPPORT=y
CONFIG_ESP_BOARD_DEV_CAMERA_SUPPORT=y
CONFIG_ESP_BOARD_DEV_FS_FAT_SUPPORT=y

#
# Camera Sensor Configuration — OV5647
#
CONFIG_CAMERA_OV5647=y
CONFIG_CAMERA_OV5647_AUTO_DETECT_MIPI_INTERFACE_SENSOR=y
CONFIG_CAMERA_OV5647_MIPI_RAW8_1280X720_30FPS=y
CONFIG_ESP_VIDEO_ENABLE_ISP_PIPELINE_CONTROLLER=y

#
# ESP32-P4 Chip Revision
#
CONFIG_ESP32P4_SELECTS_REV_LESS_V3=y

#
# Audio Configuration for ES8311 codec
#
CONFIG_ESP_CODEC_DEV_ES8311_USE_DEFAULT_CALIB_IN_FLASH=y

#
# WiFi Remote (esp_wifi_remote) config for ESP32C6 slave
#
CONFIG_ESP_WIFI_ENABLED=y
CONFIG_ESP_HOSTED_CP_TARGET_ESP32C6=y
CONFIG_ESP_HOSTED_IDF_SLAVE_TARGET="esp32c6"
```

## application/edge_agent/components/espnow_bridge/Kconfig
```kconfig
menu "ESP-NOW Bridge (S3 via UART)"

    config ESPNOW_BRIDGE_UART_PORT
        int "UART port number"
        range 0 2
        default 1
        help
            UART port used to communicate with the external ESP32-S3
            ESP-NOW bridge. Port 0 is usually reserved for the console.

    config ESPNOW_BRIDGE_UART_BAUD
        int "UART baud rate"
        default 921600
        help
            Baud rate for the S3 bridge UART. Must match the S3 side.

    config ESPNOW_BRIDGE_UART_TX_PIN
        int "UART TX pin (P4 → S3 RX)"
        default 31
        help
            GPIO number for P4 TX, connected to S3 RX.

    config ESPNOW_BRIDGE_UART_RX_PIN
        int "UART RX pin (S3 TX → P4)"
        default 30
        help
            GPIO number for P4 RX, connected to S3 TX.

    config ESPNOW_BRIDGE_UART_RX_BUFFER_SIZE
        int "RX ring buffer size"
        default 2048
        help
            Size of the UART RX ring buffer in bytes.

    config ESPNOW_BRIDGE_TASK_STACK_SIZE
        int "RX task stack size"
        default 3072
        help
            Stack size for the bridge RX task.

    config ESPNOW_BRIDGE_TASK_PRIORITY
        int "RX task priority"
        range 1 24
        default 5
        help
            FreeRTOS priority for the bridge RX task.

    config ESPNOW_BRIDGE_MAX_FRAME_SIZE
        int "Max ESP-NOW frame payload size"
        default 250
        help
            Maximum payload size for a single ESP-NOW frame (ESP-NOW limit is 250 bytes).

endmenu
```

## application/edge_agent/main/Kconfig.projbuild
```kconfig
menu "App Config"

menu "Default Wi-Fi Settings"

    config APP_WIFI_SSID
        string "Default Wi-Fi SSID"
        default ""
        help
            Default Wi-Fi SSID used to populate app settings.

    config APP_WIFI_PASSWORD
        string "Default Wi-Fi password"
        default ""
        help
            Default Wi-Fi password used to populate app settings.

    config APP_WIFI_AP_SSID_PREFIX
        string "Provisioning AP SSID prefix"
        default "esp-claw"
        help
            Prefix used to build the unique provisioning AP SSID. The full
            SSID is "<prefix>-<MAC[3..5]>" (e.g. esp-claw-84AEE5).

    config APP_WIFI_AP_CHANNEL
        int "Provisioning AP channel"
        range 1 13
        default 1
        help
            Channel used by the provisioning SoftAP.

    config APP_WIFI_AP_MAX_CONN
        int "Provisioning AP max connections"
        range 1 10
        default 4
        help
            Maximum number of concurrent stations on the provisioning AP.

    config APP_WIFI_MAX_RETRY
        int "STA max retries before AP fallback"
        range 1 20
        default 5
        help
            After this many consecutive STA connection failures the device
            falls back to pure AP mode and waits for the user to provision
            new credentials.

endmenu

menu "Default Search Settings"

    config APP_SEARCH_HTTP_ALLOWLIST
        string "Default HTTP Request allowlist"
        default "*"
        help
            Default value used to populate app setting `search_http_allowlist`.
            Use `*` to allow all hosts, or a comma-separated list of domains/IPs.

            e.g. "api.example.com,*.example.org,203.0.113.10"

endmenu

endmenu

menu "IMU & Attitude Dispatch"

    config IMU_SEND_INTERVAL_MS
        int "Attitude send interval (ms)"
        default 50
        help
            Interval between attitude transmissions.
            JY61P: 10Hz→100ms, 100Hz→10ms.

    config MOTOR_YAW_MAC
        string "YAW motor MAC"
        default "ac:a7:04:f3:56:6c"
        help
            MAC of the yaw-axis motor (selected_axis=1).

    config MOTOR_ROLL_MAC
        string "ROLL motor MAC"
        default "44:1b:f6:8b:fb:58"
        help
            MAC of the roll-axis motor (selected_axis=3).

    config MOTOR_PITCH_MAC
        string "PITCH motor MAC"
        default "ff:ff:ff:ff:ff:ff"
        help
            MAC of the pitch-axis motor (selected_axis=2).
            Set to actual MAC when known.

endmenu
```

## application/edge_agent/sdkconfig.defaults.esp32p4
```kconfig
#
# BLE config
#
CONFIG_BT_ENABLED=n
CONFIG_APP_CLAW_LUA_MODULE_BLE_HID=n

#
# PSRAM config (来自 boards/waveshare/waveshare_esp32_p4_wifi6/sdkconfig.defaults.board)
#
CONFIG_SPIRAM=y
CONFIG_SPIRAM_MODE_HEX=y
CONFIG_SPIRAM_SPEED_200M=y
CONFIG_SPIRAM_MALLOC_ALWAYSINTERNAL=0
CONFIG_SPIRAM_TRY_ALLOCATE_WIFI_LWIP=y
CONFIG_SPIRAM_XIP_FROM_PSRAM=y

#
# DNS fallback (ilinkai.weixin.qq.com needs Chinese DNS)
#
CONFIG_LWIP_FALLBACK_DNS_SERVER_SUPPORT=y
CONFIG_LWIP_FALLBACK_DNS_SERVER_ADDRESS="114.114.114.114"
```

## application/espnow_s3_bridge/main/Kconfig.projbuild
```kconfig
menu "ESP-NOW Bridge Config"

    config ESPNOW_BRIDGE_CHANNEL
        int "ESP-NOW channel (1-14)"
        range 1 14
        default 1
        help
            ESP-NOW operating channel. Must match the WiFi AP channel
            used by your slave devices (e.g. s3test's "Datura" hotspot channel).

endmenu
```

## application/espnow_slave/sdkconfig.defaults
```kconfig
CONFIG_IDF_TARGET="esp32s3"
CONFIG_ESPTOOLPY_FLASHSIZE_16MB=y
CONFIG_PARTITION_TABLE_SINGLE_APP=y

CONFIG_ESP_WIFI_ENABLED=y
CONFIG_ESP_WIFI_STATIC_RX_BUFFER_NUM=6
CONFIG_ESP_WIFI_DYNAMIC_RX_BUFFER_NUM=16
CONFIG_ESP_WIFI_DYNAMIC_TX_BUFFER=y
CONFIG_ESP_WIFI_DYNAMIC_TX_BUFFER_NUM=16
CONFIG_ESP_WIFI_AMPDU_TX_ENABLED=n
CONFIG_ESP_WIFI_AMPDU_RX_ENABLED=n
CONFIG_ESP_WIFI_NVS_ENABLED=n
CONFIG_ESP_WIFI_SOFTAP_SUPPORT=n

CONFIG_ESP_WIFI_ESPNOW_MAX_ENCRYPT_NUM=6

CONFIG_FREERTOS_HZ=1000
CONFIG_LOG_DEFAULT_LEVEL_INFO=y
CONFIG_LOG_MAXIMUM_LEVEL_INFO=y
CONFIG_COMPILER_OPTIMIZATION_SIZE=y
```
